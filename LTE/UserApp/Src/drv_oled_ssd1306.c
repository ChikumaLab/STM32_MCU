/*
 * drv_oled_ssd1306.c
 *
 *  Created on: 2022/08/01
 *      Author: User
 */


#include "drv_oled_ssd1306.h"

uint8_t oled_init_cmd[] = {0x00,0x8D,0x14,0xAF};
uint8_t oled_cler_cmd[] = {0x00,0x20,0x00,0x21,0x00,0x7F,0x22,0x00,0x07};
uint8_t oled_disp[1024 + 1];
uint8_t oled_line_data[8] = {0x01, 0x02, 0x04, 0x08, 0x10, 0x20, 0x40, 0x80};
uint8_t antData[] = {0x01,0x03,0xFF,0x03,0x01,0xC0,0x00,0xF0,0x00,0xFF};

uint8_t oled_h_pos_cmd[] = {0x00,0x20,0x02,0x00,0x00,0x00};
uint8_t oled_sig_cmd[2][6] =
{
    {0xFF, 0xFF, 0xFF, 0xFF, 0x00, 0x00},
    {0x00, 0x00, 0x00, 0x00, 0x00, 0x00}
};

I2C_HandleTypeDef *i2c_oled_ssd1306_if;


void drv_oled_ssd1306_init(I2C_HandleTypeDef *i2c)
{
	i2c_oled_ssd1306_if = i2c;

	HAL_I2C_Master_Transmit(i2c_oled_ssd1306_if, AE_SSD1306_I2C_ADDR, oled_init_cmd, (uint16_t)sizeof(oled_init_cmd),10);
}

void drv_oled_ssd1306_clear(void)
{
	int i;

	HAL_I2C_Master_Transmit(i2c_oled_ssd1306_if, AE_SSD1306_I2C_ADDR, oled_cler_cmd, sizeof(oled_cler_cmd),1000);
	oled_disp[0] = 0x40;
	for(i = 0;i < 1024;i++)
	{
		oled_disp[i +1] = 0x00;
	}
	HAL_I2C_Master_Transmit(i2c_oled_ssd1306_if, AE_SSD1306_I2C_ADDR, oled_disp, sizeof(oled_disp),1000);
}

void drv_oled_ssd1306_font_posi(uint8_t page, uint8_t column)
{
    char low_col;
    char hi_col;

    page = page + 0xB0;        // ﾍﾟｰｼﾞ情報をｺﾏﾝﾄﾞにする為に 0xB0 を加算
    low_col = column & 0x0F;
    column = column >> 4;
    hi_col = column + 0x10;
    oled_h_pos_cmd[3] = page;
    oled_h_pos_cmd[4] = low_col;
    oled_h_pos_cmd[5] = hi_col;

    HAL_I2C_Master_Transmit(i2c_oled_ssd1306_if, AE_SSD1306_I2C_ADDR, oled_h_pos_cmd, sizeof(oled_h_pos_cmd),100);
}

void drv_oled_ssd1306_set_char(uint8_t c)        // 6x8dotフォントの1文字表示関数
{
    uint8_t i;
    uint8_t txChar[7];

    c = c - 0x20;

    txChar[0] = 0x40;
    for(i=0; i<6; i++)
    {
        txChar[i + 1] = font6[c][i];
    }
	HAL_I2C_Master_Transmit(i2c_oled_ssd1306_if, AE_SSD1306_I2C_ADDR, txChar, sizeof(txChar),1000);
}

void drv_oled_ssd1306_set_h_line(uint8_t x,uint8_t y,uint8_t len)
{
	uint8_t i;
    uint8_t txData[130];
    uint8_t page = (y >> 4 ) ;
    uint8_t writeData = 0x01 << (y % 8);

    drv_oled_ssd1306_font_posi(page,x);

    txData[0] = 0x40;
    for(i = 0; i< len;i++)
    {
    	txData[i +1] =writeData;
    }
	HAL_I2C_Master_Transmit(i2c_oled_ssd1306_if, AE_SSD1306_I2C_ADDR, txData, len + 1,10);

}

void drv_oled_ssd1306_set_string(uint8_t x,uint8_t y,uint8_t *data,uint8_t len)
{
	uint8_t i;

	for(i = 0;i < len;i++)
	{
		drv_oled_ssd1306_font_posi(y, x + (i * 6));
		drv_oled_ssd1306_set_char(data[i]);
	}
}
void drv_oled_ssd1306_set_ant_param(uint8_t data)
{
    uint8_t txData[sizeof(antData) + 1];
    int i;
    drv_oled_ssd1306_font_posi(0, 0);
    txData[0] = 0x40;
    for(i = 0; i< sizeof(antData);i++)
    {
    	txData[i +1] =antData[i];
    }
    if(data < 3)
    {
    	txData[10] = 0x00;
    }
    if(data < 2)
    {
    	txData[8] = 0x00;
    }
    if(data < 1)
    {
    	txData[6] = 0x00;
    }
	HAL_I2C_Master_Transmit(i2c_oled_ssd1306_if, AE_SSD1306_I2C_ADDR, txData, sizeof(antData) + 1,1000);
}
void drv_oled_ssd1306_set_time(void)
{
	char string[32];
	uint8_t len ;
	RTC_TimeTypeDef sTime;
	RTC_DateTypeDef sDate;

	HAL_RTC_GetTime(&hrtc, &sTime, RTC_FORMAT_BIN);
	HAL_RTC_GetDate(&hrtc, &sDate, RTC_FORMAT_BIN);


//	sprintf(string,"20%02d %02d/%02d %02d%:%02d:%02d",sDate.Year,sDate.Month,sDate.Date,sTime.Hours,sTime.Minutes,sTime.Seconds);
	sprintf(string,"%02d:%02d:%02d",sTime.Hours,sTime.Minutes,sTime.Seconds);
	len = strlen(string);
	drv_oled_ssd1306_set_string(20,0,(uint8_t*)string,len);
}
void drv_oled_ssd1306_set_temp_param(float data)
{
	char string[32];
	uint8_t len ;

	sprintf(string,"%0.2fdeg",data);
	len = strlen(string);
	drv_oled_ssd1306_set_string(30,2,(uint8_t*)string,len);
}

void drv_oled_ssd1306_set_humdity_param(float data)
{
	char string[32];
	uint8_t len ;

	sprintf(string,"%0.2f%%",data);
	len = strlen(string);
	drv_oled_ssd1306_set_string(30,4,(uint8_t*)string,len);
}

void drv_oled_ssd1306_set_presser_param(float data)
{
	char string[32];
	uint8_t len ;

	sprintf(string,"%0.2fhPa",data);
	len = strlen(string);
	drv_oled_ssd1306_set_string(30,6,(uint8_t*)string,len);
}


void drv_oled_ssd1306_set_batt_param(uint8_t data)
{
    uint8_t txData[17];
    int i;

    uint8_t buf = data / 10 ;

    for(i = 2;i < 15;i++)
    {
        txData[i] = 0x81;
    }
    for(i = 0;i < buf;i++)
    {
        txData[i+3] = 0xBD;
    }

    drv_oled_ssd1306_font_posi(0, 100);
    txData[0] = 0x40;
    txData[1] = 0xFF;
    txData[15] = 0xE7;
    txData[16] = 0x3C;

	HAL_I2C_Master_Transmit(i2c_oled_ssd1306_if, AE_SSD1306_I2C_ADDR, txData, sizeof(txData) ,1000);

}

void drv_oled_ssd1306_set_lte_qual(uint8_t rssi,uint8_t rsrp,uint8_t rsrq, uint8_t sinr)
{
	char string[32];
	uint8_t len ;

	sprintf(string,"RSSI(%d),RSRP(%d)",rssi,rsrp);
	len = strlen(string);
	drv_oled_ssd1306_set_string(0,1,(uint8_t*)string,len);

	sprintf(string,"RSRQ(%d),SINR(%d)",rsrq,sinr);
	len = strlen(string);
	drv_oled_ssd1306_set_string(0,2,(uint8_t*)string,len);
}

void drv_oled_ssd1306_set_lte_cellData(uint8_t tac,uint8_t cell)
{
	char string[32];
	uint8_t len ;

	sprintf(string,"TAC(%d),CELL(%d)",tac,cell);
	len = strlen(string);
	drv_oled_ssd1306_set_string(0,3,(uint8_t*)string,len);
}

void drv_oled_ssd1306_set_lte_band(uint8_t band,uint8_t bandwide,uint8_t ulink)
{
	char string[32];
	uint8_t len ;

	sprintf(string,"BAND(%d),Wide(%d)",band,bandwide);
	len = strlen(string);
	drv_oled_ssd1306_set_string(0,4,(uint8_t*)string,len);
	sprintf(string,"U-link(%d)",ulink);
	len = strlen(string);
	drv_oled_ssd1306_set_string(0,5,(uint8_t*)string,len);
}

const char font6[91][6] =
{
    { 0x00, 0x00, 0x00, 0x00, 0x00, 0x00 }, // " " 0x20
    { 0x00, 0x00, 0x4f, 0x00, 0x00, 0x00 }, // ! 0x21
    { 0x00, 0x07, 0x00, 0x07, 0x00, 0x00 }, // " 0x22
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    { 0x44, 0x64, 0x54, 0x4c, 0x44, 0x00 } // z 0x7A
}; // 6x8dot
